## sdkconfig.defaults
```kconfig
# CONFIG_ESP_MAIN_TASK_STACK_SIZE=20000
# CONFIG_ESP_SYSTEM_EVENT_TASK_STACK_SIZE=4096

# Rust often needs a bit of an extra main task stack size compared to C (the default is 3K)
CONFIG_ESP_MAIN_TASK_STACK_SIZE=20000
CONFIG_PTHREAD_TASK_STACK_SIZE_DEFAULT=4096
CONFIG_ESP_SYSTEM_EVENT_TASK_STACK_SIZE=4096

CONFIG_LOG_DEFAULT_LEVEL=LOG_DEFAULT_LEVEL_VERBOSE

CONFIG_BT_ENABLED=y
CONFIG_BT_BLE_ENABLED=y
CONFIG_BT_BLUEDROID_ENABLED=n
CONFIG_BT_NIMBLE_ENABLED=y
# CONFIG_BT_NIMBLE_EXT_ADV=y

CONFIG_BTDM_CTRL_MODE_BLE_ONLY=y
CONFIG_BTDM_CTRL_MODE_BR_EDR_ONLY=n
CONFIG_BTDM_CTRL_MODE_BTDM=n

CONFIG_ESP32_SPIRAM_SUPPORT=y

CONFIG_PARTITION_TABLE_OFFSET=0x8000

#CONFIG_IDF_TARGET_ESP32=y
CONFIG_IDF_TARGET_ESP32S3=y
#CONFIG_IDF_TARGET_ESP32S3=y
#CONFIG_ESPTOOLPY_FLASHMODE_QIO=y
#CONFIG_ESPTOOLPY_FLASHSIZE_16MB=y
#CONFIG_PARTITION_TABLE_OFFSET=0x8000
#CONFIG_ESP32S3_DEFAULT_CPU_FREQ_240=y
#CONFIG_ESP32S3_INSTRUCTION_CACHE_32KB=y
#CONFIG_ESP32S3_DATA_CACHE_64KB=y
#CONFIG_ESP32S3_DATA_CACHE_LINE_64B=y
CONFIG_ESP32S3_SPIRAM_SUPPORT=y
CONFIG_SPIRAM_MODE_OCT=y
CONFIG_SPIRAM_SPEED_80M=y

CONFIG_ESP_SYSTEM_PANIC_PRINT_REBOOT=y

#CONFIG_ESP_SYSTEM_RTC_FAST_MEM_AS_HEAP_DEPCHECK=y
#CONFIG_ESP_SYSTEM_ALLOW_RTC_FAST_MEM_AS_HEAP=y

CONFIG_MODEL_IN_SPIFFS=y
CONFIG_USE_AFE=y
CONFIG_AFE_INTERFACE_V1=y
#CONFIG_USE_WAKENET=y
#CONFIG_SR_WN_WN9_HILEXIN=y

#CONFIG_USE_MULTINET=n
#CONFIG_SR_WN_LOAD_MULIT_WORD=y

#
# Load Multiple Wake Words
#
#CONFIG_SR_WN_WN9_HILEXIN_MULTI=y
#CONFIG_SR_WN_WN9_HIESP_MULTI=y

CONFIG_ESP_TLS_INSECURE=y
CONFIG_ESP_TLS_SKIP_SERVER_CERT_VERIFY=y

# Disables task watchdog
CONFIG_ESP_TASK_WDT_EN=n
```
